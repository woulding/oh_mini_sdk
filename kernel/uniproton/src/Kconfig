## kernel/uniproton/src/Kconfig
```kconfig
mainmenu "UniProton Configuration"

#should source arch Kconfig first
source "arch/Kconfig"
source "core/Kconfig"
source "mem/Kconfig"
source "om/Kconfig"
source "security/Kconfig"
source "fs/Kconfig"
source "net/Kconfig"
osource "../../../drivers/hdf_core/adapter/khdf/uniproton/Kconfig"
source "utility/Kconfig"
```
