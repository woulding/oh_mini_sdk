## device/soc/hisilicon/ws53v106/sdk/drivers/drivers/driver/pcm/Kconfig
```kconfig
#===============================================================================
# @brief    Kconfig file.
# Copyright (c) HiSilicon (Shanghai) Technologies Co., Ltd. 2022-2022. All rights reserved.
#===============================================================================

config PCM_SUPPORT_LOOPBACK
    bool
    prompt "PCM Support LOOPBACK"
    default n
    depends on DRIVER_SUPPORT_PCM

config PCM_RX_THRESHOLD
    hex
    prompt "Threshold of the PCM RX channel"
    default 0xC
    depends on DRIVER_SUPPORT_PCM

config PCM_TX_THRESHOLD
    hex
    prompt "Threshold of the PCM TX channel"
    default 0xC
    depends on DRIVER_SUPPORT_PCM
```

## device/soc/hisilicon/ws53v106/sdk/drivers/drivers/driver/sdio/Kconfig
```kconfig
#===============================================================================
# @brief    Kconfig file.
# Copyright (c) HiSilicon (Shanghai) Technologies Co., Ltd. 2023-2023. All rights reserved.
#===============================================================================

config SDIO_EXTEND_INFO
    bool
    prompt "SDIO EXTEND INFO"
    default n
    depends on DRIVER_SUPPORT_SDIO
```

## device/soc/hisilicon/ws53v106/sdk/drivers/drivers/driver/uart/Kconfig
```kconfig
#===============================================================================
# @brief    Kconfig file.
# Copyright (c) HiSilicon (Shanghai) Technologies Co., Ltd. 2022-2022. All rights reserved.
#===============================================================================
config UART_BAUD_RATE_DIV_8
    bool
    prompt "UART Baud rate div 8."
    default y
    depends on DRIVER_SUPPORT_UART

config UART_SUPPORT_TX
    bool
    prompt "UART support TX."
    default y
    depends on DRIVER_SUPPORT_UART

config UART_SUPPORT_TX_INT
    bool
    prompt "UART support TX interrupt mode."
    default y
    depends on DRIVER_SUPPORT_UART

config UART_SUPPORT_RX
    bool
    prompt "UART support RX."
    default y
    depends on DRIVER_SUPPORT_UART

config SUPPORT_UART_POLL_TIMEOUT
    bool
    prompt "add timeout in uart poll mode."
    default n
    depends on UART_SUPPORT_RX

config UART_SUPPORT_DMA
    bool
    prompt "UART support dma."
    default y
    depends on DRIVER_SUPPORT_UART
    select DRIVER_SUPPORT_DMA

config UART_SUPPORT_SEND_IN_DMA_ISR
    bool
    prompt "UART Support send in dma isr"
    default n
    depends on DRIVER_SUPPORT_DMA

config UART_SUPPORT_INT_TRIGGER_DMA
    bool
    prompt "UART support rx interrupt trigger dma."
    default y
    depends on UART_SUPPORT_DMA

config UART_SUPPORT_DMA_LLI
    bool
    prompt "UART Support DMA lli transport."
    default n
    depends on UART_SUPPORT_DMA

config UART_LLI_BAUDRATE
    int
    prompt "UART LLI BAUDRATE. Depends on hardware constraints."
    range 115200 4000000
    default 115200
    depends on UART_SUPPORT_DMA_LLI

config UART_SUPPORT_RECV_RAW_DATA
    bool
    prompt "UART support receive raw data"
    default n
    depends on UART_SUPPORT_DMA_LLI

config UART_FIFO_INT_RX_LEVEL
    int
    prompt "UART fifo int rx level"
    range 0 4
    default 2
    depends on UART_SUPPORT_RECV_RAW_DATA

config DMA_WAIT_UART_IDLE_INT_LEN
    int
    prompt "UART DMA receive max length."
    range 0 4096
    default 1024
    depends on UART_SUPPORT_RECV_RAW_DATA

config UART_IDLE_PAYLOAD_LEN
    int
    prompt "UART IDLE receive max length."
    range 0 256
    default 64
    depends on UART_SUPPORT_RECV_RAW_DATA

config UART_SUPPORT_FLOW_CTRL
    bool
    prompt "UART support flow control."
    default n
    depends on DRIVER_SUPPORT_UART

config UART_SUPPORT_HW_FLOW_CTRL
    bool
    prompt "UART support hardware flow control."
    default n
    depends on UART_SUPPORT_FLOW_CTRL

config UART_SUPPORT_SW_FLOW_CTRL
    bool
    prompt "UART support software flow control."
    default n
    depends on UART_SUPPORT_FLOW_CTRL

config UART_SUPPORT_LPM
    bool
    prompt "UART support low power mode, supend and reusme."
    default y
    depends on DRIVER_SUPPORT_UART

config UART_FIFO_DEPTH
    int
    prompt "UART FIFO depth."
    range 64 128
    default 64
    depends on DRIVER_SUPPORT_UART

config UART_SUPPORT_LPC
    bool
    prompt "UART support low power control, control power and clock."
    default n
    depends on DRIVER_SUPPORT_UART

config UART_MULTI_CORE_RESUME
    bool
    prompt "UART support low power resume skip some port for multi-core."
    default n
    depends on UART_SUPPORT_LPM

config UART_NOT_SUPPORT_RX_CONDITON_SIZE_OPTIMIZE
    bool
    prompt "UART don't support rx condition size optimization."
    default n
    depends on UART_SUPPORT_RX

config UART_SUPPORT_RX_FRAME_CALLBACK
    bool
    prompt "UART support rx frame callback."
    default n
    depends on UART_NOT_SUPPORT_RX_CONDITON_SIZE_OPTIMIZE

config UART_SUPPORT_RX_FRAME_TIMER
    int
    prompt "UART support rx frame timer."
    default 1
    depends on UART_SUPPORT_RX_FRAME_CALLBACK

config UART_SUPPORT_QUERY_REGS
    bool
    prompt "UART support query regs values."
    default n
    depends on DRIVER_SUPPORT_UART

config UART_L0_TX_PIN
    int
    prompt "UART config uart L0 tx pin."
    default 19
    depends on DRIVER_SUPPORT_UART

config UART_L0_RX_PIN
    int
    prompt "UART config uart L0 rx pin."
    default 20
    depends on DRIVER_SUPPORT_UART

config UART_H0_TX_PIN
    int
    prompt "UART config uart H0 tx pin."
    default 17
    depends on DRIVER_SUPPORT_UART

config UART_H0_RX_PIN
    int
    prompt "UART config uart H0 rx pin."
    default 18
    depends on DRIVER_SUPPORT_UART

config UART_H0_CTS_PIN
    int
    prompt "UART config uart h0 cts pin, which is not used by default"
    default 100
    depends on UART_SUPPORT_FLOW_CTRL

config UART_H0_RTS_PIN
    int
    prompt "UART config uart h0 rts pin, which is not used by default"
    default 100
    depends on UART_SUPPORT_FLOW_CTRL
```

## device/soc/hisilicon/ws53v106/sdk/middleware/chips/ws53/Kconfig
```kconfig
#===============================================================================
# @brief    Kconfig file.
# Copyright (c) @CompanyNameMagicTag 2023-2023. All rights reserved.
#===============================================================================
config MIDDLEWARE_SUPPORT_FTM
    bool
    prompt "FTM"
    default n
    help
        This option means support FTM.

config MIDDLEWARE_SUPPORT_NV
    bool
    prompt "NV"
    default n
    help
        This option means support nv.
config MIDDLEWARE_NV_SUPPORT_HSO_ACCESS
    bool
    depends on MIDDLEWARE_SUPPORT_NV
    prompt "NV Support HSO Access"
    default n
    help
        This option means nv support HSO access.

config PARTITION_FEATURE_SUPPORT
    bool
    depends on MIDDLEWARE_SUPPORT_NV
    prompt "NV Support HSO Access"
    default n
    help
        This option means nv support get addr by partition feature.

config MIDDLEWARE_SUPPORT_UPG
    bool
    prompt "FOTA"
    default n
    help
        This option means support FOTA.

config MIDDLEWARE_SUPPORT_UPG_COMPRESS
    default y
    depends on MIDDLEWARE_SUPPORT_UPG
    bool "FOTA for compress"

config MIDDLEWARE_SUPPORT_UPG_AB
    default n
    depends on MIDDLEWARE_SUPPORT_UPG
    bool "FOTA for AB"

config MIDDLEWARE_SUPPORT_UPG_COMPRESS_ENCRY
    bool
    prompt "OTA for compress encry"
    default y
    depends on MIDDLEWARE_SUPPORT_UPG_COMPRESS
    help
        This option means support FOTA for compress encry.

config MIDDLEWARE_SUPPORT_UPG_SAMPLE_VERIFY
    bool
    prompt "OTA for sample verify"
    default y
    depends on MIDDLEWARE_SUPPORT_UPG
    help
        This option means support FOTA for compress encry.
config SUPPORT_CRASHINFO_SAVE_TO_FLASH
    bool
    prompt "save crash info into flash"
    default n
choice
    prompt "Exception Mode"
    default SUPPORT_EXCEPT_REBOOT
    config SUPPORT_EXCEPT_REBOOT
        bool "Reboot-after-exception"
    config SUPPORT_EXCEPT_WAITFOREVE
        bool "Wait-after-exception"
endchoice
config SUPPORT_EXCEPT_DISABLE_WDT
    bool
    prompt "Disable wdt after exception"
    default n
    help
        This option means support disable wdt after exception.
config MIDDLEWARE_SUPPORT_LFS
    bool
    prompt "littlefs adapt"
    default n
    help
        This option means support little file system.
config LFS_PARTITION_ID
    int
    depends on MIDDLEWARE_SUPPORT_LFS
    prompt "littlefs flash partition ID"
    default 38
    help
        This option means support little file system partition ID.
config LFS_ADAPT_DEBUG
    bool
    depends on MIDDLEWARE_SUPPORT_LFS
    prompt "littlefs adapt debug print"
    default n
    help
        This option means support little file system debug print.
config LFS_ADAPT_WARN
    bool
    depends on MIDDLEWARE_SUPPORT_LFS
    prompt "littlefs adapt warn print"
    default n
    help
        This option means support little file system warn print.
config LFS_ADAPT_ERROR
    bool
    depends on MIDDLEWARE_SUPPORT_LFS
    prompt "littlefs adapt error print"
    default y
    help
        This option means support little file system error print.
```

## device/soc/hisilicon/ws53v106/sdk/middleware/utils/at/Kconfig
```kconfig
#===============================================================================
# @brief    Kconfig file.
# Copyright (c) HiSilicon (Shanghai) Technologies Co., Ltd. 2022-2023. All rights reserved.
#===============================================================================
config AT_SUPPORT_PLT
    bool
    prompt "platform at command"
    default n
    help
        This option means at support plt.

config AT_DEBUG_REGISTER_CCPRIV
    bool
    prompt "ccpriv at debug command"
    default n
    help
        This option means at support ccpriv.

if AT_SUPPORT_PLT
menu "Config AT CFBB"
    comment "Config AT CFBB"
    osource  "middleware/utils/at/at/Kconfig"
endmenu
endif
```

## device/soc/hisilicon/ws53v106/sdk/protocol/Kconfig
```kconfig
#===============================================================================
# @brief    Kconfig file.
# Copyright (c) @CompanyNameMagicTag 2023-2023. All rights reserved.
#===============================================================================
menu "bt_host"
    comment "Config bluetooth."
    osource "protocol/bt/host/Kconfig"
endmenu

menu "bt_controller"
    comment "Config bluetooth."
    osource "protocol/bt/controller/Kconfig"
endmenu

menu "nfc"
    config SUPPORT_NFC_SERVICE
    bool
    prompt "Config nfc."
    default n
    help
        This option means support NFC.
endmenu

menu "wifi"
    comment "Config wifi."
endmenu

config RADAR_SERVICE
    bool
    prompt "Enable Radar."
    default n
    help
        This option means support Radar.

if RADAR_SERVICE
menu "radar"
    comment "Config radar."
    osource "protocol/radar/plat/Kconfig"
endmenu
endif
```
