## device/soc/hisilicon/bs2xv107/sdk/application/samples/peripheral/cmp/Kconfig
```kconfig
#===============================================================================
# @brief    Kconfig file.
# Copyright (c) HiSilicon (Shanghai) Technologies Co., Ltd. 2025-2025. All rights reserved.
#===============================================================================
config CMP_REFERENCE_VOLTAGE
    int
    prompt "Comparator reference voltage(mv)."
    default 250
    depends on SAMPLE_SUPPORT_CMP

config CMP_CHANNEL
    int
    prompt "Choose CMP channel(S_MGPIO2, S_MGPIO3, S_MGPIO4, S_MGPIO5, S_MGPIO28, S_MGPIO29, S_MGPIO30, S_MGPIO31)."
    default 4
    depends on SAMPLE_SUPPORT_CMP

config POLE_SEL
    int
    prompt "Polarity Select(0 HIGH, 1 LOW)."
    default 0
    depends on SAMPLE_SUPPORT_CMP

config CMP_SUPPORT_INT_MODE
    bool
    prompt "CMP support interrupt mode."
    depends on SAMPLE_SUPPORT_CMP
    default n
```

## device/soc/hisilicon/bs2xv107/sdk/drivers/drivers/hal/sio/Kconfig
```kconfig
#===============================================================================
# @brief    Kconfig file.
# Copyright (c) HiSilicon (Shanghai) Technologies Co., Ltd. 2022-2023. All rights reserved.
#===============================================================================
config SIO_USING_V150
    bool
    prompt "SIO Using V150"
    default n

config DATA_LEN_MAX
    int
    prompt "DATA_LEN_MAX"
    default 128
    depends on SIO_USING_V150

config I2S_RX_THRESHOLD
    hex
    prompt "Threshold of the I2S RX channel"
    default 0x0
    depends on SIO_USING_V150

config I2S_TX_THRESHOLD
    hex
    prompt "Threshold of the I2S TX channel"
    default 0x0
    depends on SIO_USING_V150

config I2S_BCLK_DIV_NUM
    hex
    prompt "NUM of the I2S BCLK DIV"
    default 0x4
    depends on SIO_USING_V150

config SIO_USING_V151
    bool
    prompt "SIO Using V151"
    default n

config I2S_OUTER_CLK_IN
    bool
    prompt "I2S use outer mclk."
    default n
    depends on SIO_USING_V151

config I2S_MCLK_PIN
    int
    prompt "Choose I2S MCLK pin."
    depends on I2S_OUTER_CLK_IN
    default 12

config I2S_MCLK_PIN_MODE
    int
    prompt "Choose MCLK WS pin mode."
    depends on I2S_OUTER_CLK_IN
    default 39
```

## device/soc/hisilicon/ws53v106/sdk/application/samples/bt/ble/Kconfig
```kconfig
#===============================================================================
# @brief    Kconfig file.
# Copyright (c) HiSilicon (Shanghai) Technologies Co., Ltd. 2023-2023. All rights reserved.
#===============================================================================

choice
    prompt "BLE Sample"

config SAMPLE_SUPPORT_BLE_SPEED_SERVER_SAMPLE
    bool "Support BLE Throughput Server Sample."

config SAMPLE_SUPPORT_BLE_CFG_SAMPLE
    bool "Support BLE WIFI CFG Sample"

endchoice
```

## device/soc/hisilicon/ws53v106/sdk/application/samples/peripheral/lpc/Kconfig
```kconfig
#===============================================================================
# @brief    Kconfig file.
# Copyright (c) HiSilicon (Shanghai) Technologies Co., Ltd. 2024-2024. All rights reserved.
#===============================================================================
config LPC_GPIO_WAKEUP_PIN
    int
    prompt "Choose lpc gpio wakeup pin."
    depends on SAMPLE_SUPPORT_LPC
    default 0
```

## device/soc/hisilicon/ws53v106/sdk/application/samples/peripheral/rtc/Kconfig
```kconfig
#===============================================================================
# @brief    Kconfig file.
# Copyright (c) HiSilicon (Shanghai) Technologies Co., Ltd. 2023-2023. All rights reserved.
#===============================================================================
config RTC_INDEX
    int
    prompt "Choose RTC Test Index."
    depends on SAMPLE_SUPPORT_RTC
    default 0

config RTC_IRQN
    int
    prompt "Choose RTC Test Irq Number."
    depends on SAMPLE_SUPPORT_RTC
    default 49

config RTC_PRIO
    int
    prompt "Choose RTC Test Priority."
    depends on SAMPLE_SUPPORT_RTC
    default 1
```

## device/soc/hisilicon/ws53v106/sdk/application/samples/wifi/Kconfig
```kconfig
#===============================================================================
# @brief    Kconfig file.
# Copyright (c) HiSilicon (Shanghai) Technologies Co., Ltd. 2023-2023. All rights reserved.
#===============================================================================
choice
    prompt "Sample"

config SAMPLE_SUPPORT_STA_SAMPLE
    bool "Support WIFI STA Sample"

if SAMPLE_SUPPORT_STA_SAMPLE
osource "application/samples/wifi/sta_sample/Kconfig"
endif

config SAMPLE_SUPPORT_SOFTAP_SAMPLE
    bool "Support WIFI SoftAP Sample."

config SAMPLE_SUPPORT_BLE_WIFI_CFG_SAMPLE
    bool "Support BLE WIFI CFG Sample"

config SUPPORT_HILINK
    bool "Support HILINK"

config SUPPORT_UAPI
    bool "Support UAPI."

config SUPPORT_TCP_CLIENT_SAMPLE
    bool "Support TCP client"
    help
        This option means support TCP client

config SUPPORT_TCP_SERVER_SAMPLE
    bool "Support TCP server"
    help
        This option means support TCP server
endchoice

config SAMPLE_SUPPORT_SYSCHANNEL_DEV
    bool
    prompt "Support Syschannel dev Sample."
    default n
    help
        This option means support Syschannel Dev Sample.
```

## device/soc/hisilicon/ws53v106/sdk/bootloader/commonboot/Kconfig
```kconfig
#===============================================================================
# @brief    Kconfig file.
# Copyright (c) HiSilicon (Shanghai) Technologies Co., Ltd. 2022-2023. All rights reserved.
#===============================================================================

config BOOT_SUPPORT_HASH
    bool
    prompt "Hash"
    default n
    depends on BOOT_SUPPORT_SEC
    help
        This option means boot support hash check.

config BOOT_SUPPORT_ECC_VERIFY
    bool
    prompt "Ecc Verify"
    default n
    depends on BOOT_SUPPORT_SECURE_VERIFY
    help
        This option means boot support ecc verify.

config BOOT_SUPPORT_SM2_VERIFY
    bool
    prompt "Sm2 Verify"
    default n
    depends on BOOT_SUPPORT_SECURE_VERIFY
    help
        This option means boot support sm2 verify.

config BOOT_SUPPORT_RSA3072_VERIFY
    bool
    prompt "Rsa3072 Verify"
    default n
    depends on BOOT_SUPPORT_SECURE_VERIFY
    help
        This option means boot support rsa3072 verify.

config BOOT_SUPPORT_RSA4096_VERIFY
    bool
    prompt "Rsa4096 Verify"
    default n
    depends on BOOT_SUPPORT_SECURE_VERIFY
    help
        This option means boot support rsa4096 verify.

config BOOT_SUPPORT_SOFT_VERIFY
    bool
    prompt "Soft Verify"
    default n
    depends on BOOT_SUPPORT_SECURE_VERIFY
    help
        This option means boot support soft verify.

config FLASH_BOOT_SUPPORT_ROM_API
    bool
    prompt "flashboot support rom API"
    default n
    depends on BOOT_SUPPORT_SECURE_VERIFY
    help
        This option means flashboot support rom API.

if CHIP_WS63 || CHIP_WS53
    config ROM_EXPEND_SUPPORT_NOT_ALIGNED
        bool
        prompt "expand rom sha256 API to support data_length not 64 bytes aligned. only need by ws63 & ws53."
        default n
        depends on FLASH_BOOT_SUPPORT_ROM_API
        help
            This option means the sha256 data_length support not 64 bytes aligned.
    config BOOT_SUPPORT_SECURE_VERIFY_V1
        bool "support secure verify boot version1."
        default y
endif

config LOADERBOOT_SUPPORT_SW_HASH
    bool
    prompt "Loaderboot Support Software Hash"
    default n
    depends on LOADERBOOT_SUPPORT_EFUSE_BURN
    help
        This option means flashboot support software hash.

if BOOT_SUPPORT_SECURE_VERIFY && !BOOT_SUPPORT_SECURE_VERIFY_V1
    config BOOT_SUPPORT_SECURE_VERIFY_V2
        bool "support secure verify boot version2."
        default y
    config BOOT_SUPPORT_DOUBLE_TRUST_CHAIN
        bool "support double trust chain"
        default y
    config BOOT_SUPPORT_CHECK_VERSION
        bool "support versionn check"
        default y
    config BOOT_SUPPORT_CHECK_MSID
        bool "support msid check"
        default y
endif
```

## device/soc/hisilicon/ws53v106/sdk/drivers/chips/Kconfig
```kconfig
#===============================================================================
# @brief    Kconfig file.
# Copyright (c) HiSilicon (Shanghai) Technologies Co., Ltd. 2022-2022. All rights reserved.
#===============================================================================

choice
    prompt "Choose Chip"
    default CHIP_BS2X
config CHIP_WS53
    bool "ws53"

config CHIP_WS63
    bool "ws63"

config CHIP_BS2X
    bool "bs2x"

config CHIP_SW39
    bool "sw39"

config CHIP_FHL2
    bool "fenghuolunv200"
endchoice

if CHIP_WS53
menu "Chip Configurations for ws53"
    comment "Config ws53"
    osource "drivers/chips/ws53/Kconfig"
endmenu
endif

if CHIP_WS63
menu "Chip Configurations for ws63"
    comment "Config ws63"
    osource "drivers/chips/ws63/Kconfig"
endmenu
endif

if CHIP_BS2X
menu "Chip Configurations for bs2x"
    comment "bs2x chipset resource config"
    osource "drivers/chips/bs2x/Kconfig"
endmenu
endif

if CHIP_SW39
menu "Chip Configurations for sw39"
    comment "sw39 chipset resource config"
    osource "drivers/chips/sw39/Kconfig"
endmenu
endif

if CHIP_FHL2
menu "Chip Configurations for fenghuolunv200"
    comment "fenghuolunv200 chipset resource config"
    osource "drivers/chips/fhl2/boot/commonboot/Kconfig"
endmenu
endif
```

## device/soc/hisilicon/ws53v106/sdk/drivers/chips/ws53/Kconfig
```kconfig
#===============================================================================
# @brief    Kconfig file.
# Copyright (c) HiSilicon (Shanghai) Technologies Co., Ltd. 2023-2023. All rights reserved.
#===============================================================================

choice
    prompt "Working mode, choose one of them"
    default MCU_MODE_1

    config MCU_MODE_1
        bool "MCU_MODE_1: ARAM: 384K, CRAM: 96K, PKT:64K, BT:32K, DIAG:0K"

    config MCU_MODE_2
        bool "MCU_MODE_2: ARAM: 416K, CRAM: 88K, PKT:56K, BT:16K, DIAG:0K"

    config MCU_MODE_3
        bool "MCU_MODE_3: ARAM: 448K, CRAM: 64K, PKT:64K, BT:0K, DIAG:0K"

    config MCU_MODE_4
        bool "MCU_MODE_4: ARAM: 416K, CRAM: 96K, PKT:64K, BT:0K, DIAG:0K"

    config DEVICE_MODE
        bool "DEVICE_MODE: ARAM: 192K, CRAM: 288K, PKT:64K, BT:32K, DIAG:0K"

    config DIAG_MODE
        bool "DIAG_MODE: ARAM: 384K, CRAM: 104K, PKT:32K, BT:24K, DIAG:32K"

endchoice

config PRINTF_BUFFER_DYNAMIC
    bool
    prompt "support long size print over 128 Bytes"
    default y

config HSO_UART_SUPPORT
    bool
    prompt "support HSO uart"
    default y

choice
    prompt "configure uart port for HSO, choose one of them."
    default UART_HSO_PORT_H0
    depends on HSO_UART_SUPPORT
    config UART_HSO_PORT_L0
        bool "UART_L0"
    config UART_HSO_PORT_H1
        bool "UART_H1"
    config UART_HSO_PORT_H0
        bool "UART_H0"
endchoice

config DIAG_BEAT_HEART_SUPPORT
    bool
    prompt "support HSO keepalive"
    default n
    depends on HSO_UART_SUPPORT

config DIAG_BEAT_HEART_PER_TIME
    int
    prompt "HSO keepalive interval(ms)"
    default 1000
    help
        This option is HSO keepalive interval
    depends on DIAG_BEAT_HEART_SUPPORT

config DIAG_BEAT_HEART_TOTAL_TIME
    int
    prompt "HSO keepalive threshold(s)"
    default 2
    help
        This option is HSO keepalive threshold
    depends on DIAG_BEAT_HEART_SUPPORT

config HSO_UART_BAUD_RATE
    int
    prompt "configure uart port baud rate for HSO"
    default 921600
    help
        This option means hso log uart baud rate
    depends on HSO_UART_SUPPORT

config DEBUG_UART_SUPPORT
    bool
    prompt "support DEBUG uart"
    default y

choice
    prompt "configure uart port for debug, choose one of them."
    default UART_DEBUG_PORT_L0
    depends on DEBUG_UART_SUPPORT
    config UART_DEBUG_PORT_L0
        bool "UART_L0"
    config UART_DEBUG_PORT_H1
        bool "UART_H1"
    config UART_DEBUG_PORT_H0
        bool "UART_H0"
endchoice

config DEBUG_UART_BAUD_RATE
    int
    prompt "configure uart port baud rate for debug."
    range 9600 2000000
    default 115200
    depends on DEBUG_UART_SUPPORT

config AT_UART_SUPPORT
    bool
    prompt "support AT uart"
    default y

choice
    prompt "configure uart port for AT, choose one of them."
    default UART_AT_PORT_L0
    depends on AT_UART_SUPPORT
    config UART_AT_PORT_L0
        bool "UART_L0"
    config UART_AT_PORT_H1
        bool "UART_H1"
endchoice

config AT_UART_BAUD_RATE
    int
    prompt "configure uart port baud rate for AT."
    range 9600 2000000
    default 115200
    depends on AT_UART_SUPPORT

choice
    prompt "configure UART_H0 pin setting"
    default UART_H0_PINSET_2
    config UART_H0_PINSET_1
        bool "TX MGPIO8 RX MGPIO9"
    config UART_H0_PINSET_2
        bool "TX MGPIO17 RX MGPIO18"
endchoice

config UART_SUPPORT_PORTTING_IRQ
    bool
    prompt "support uart portting irq"
    default n

config SEC_UPGRADE_VERSION_VALIDATE
    bool
    prompt "configure anti-rollback write version to efuse."
    default n
    depends on DRIVER_SUPPORT_EFUSE

config DYNAMIC_UART_ID_BINDDING
    bool
    prompt "support specify uart bus id in runtime(may apply after reboot)"
    depends on MIDDLEWARE_SUPPORT_NV
    default n

config UART_L0_NOT_SUPPORT_RX
    bool
    prompt "close uart l0 rx configuration"
    default n

config ACORE_CPU_TRACE
    bool
    prompt "support system mcpu trace"
    default n

config SUPPORT_RST_RSN_SAVE_TO_FLASH
    bool
    prompt "save reboot reason into flash"
    default n
```

## device/soc/hisilicon/ws53v106/sdk/drivers/chips/ws53/rom/app/drivers/drivers/driver/sdio/Kconfig
```kconfig
#===============================================================================
# @brief    Kconfig file.
# Copyright (c) @CompanyNameMagicTag 2023-2023. All rights reserved.
#===============================================================================

config SDIO_EXTEND_INFO
    bool
    prompt "SDIO EXTEND INFO"
    default n
    depends on DRIVER_SUPPORT_SDIO
```

## device/soc/hisilicon/ws53v106/sdk/drivers/chips/ws53/rom/app/drivers/drivers/hal/sdio/Kconfig
```kconfig
#===============================================================================
# @brief    Kconfig file.
# Copyright (c) @CompanyNameMagicTag 2023-2023. All rights reserved.
#===============================================================================
config SDIO_MEM_CARD_MODE
    bool
    prompt "MEM_CARD_MODE"
    default n
    depends on DRIVER_SUPPORT_SDIO

config SDIO_TURNING_SUPPORT
    bool
    prompt "SDIO TURNING SUPPORT"
    default n
    depends on DRIVER_SUPPORT_SDIO

config SDIO_WAIT
    hex
    prompt "SDIO WAIT CARD READY"
    range 0x0 0xFFFFFFFF
    default 0xFFFFFFFF
    depends on DRIVER_SUPPORT_SDIO

config SDIO_USING_V120
    bool
    prompt "Using the SDIO V120"
    default n
    depends on DRIVER_SUPPORT_SDIO

config SDIO_USING_V151
    bool
    prompt "Using the SDIO V151"
    default n
    depends on DRIVER_SUPPORT_SDIO
```

## device/soc/hisilicon/ws53v106/sdk/drivers/chips/ws53/rom/app/middleware/utils/Kconfig
```kconfig
#===============================================================================
# @brief    Kconfig file.
# Copyright (c) @CompanyNameMagicTag 2022-2022. All rights reserved.
#===============================================================================
config MIDDLEWARE_SUPPORT_PM
    bool
    prompt "PM"
    default y
    help
        This option means support pm.

if MIDDLEWARE_SUPPORT_PM
menu "PM Configuration"
    comment "Config PM"
    osource  "middleware/utils/pm/Kconfig"
endmenu
endif

config MIDDLEWARE_SUPPORT_DFX
    bool
    prompt "DFX"
    default y
    help
        This option means support dfx.

if MIDDLEWARE_SUPPORT_DFX
menu "Design for Maintainable and Testable Configuration"
    comment "Config DFM & DFT"
    osource  "middleware/utils/dfx/Kconfig"
endmenu
endif
```
